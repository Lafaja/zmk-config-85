#include <dt-binding/zmk/matrix_transform.h>
/ {
    model= "calf";

    chosen {
        zmk,kscan = &kscan0;
        zmk,matrix_transform = &default_transform;
    };

 default_transform: keymap_transform_0 {
        compatible = "zmk,matrix-transform";
        columns = <9>;
        rows = <5>;

        map = <
            RC(1,1) RC(NC) RC(1,3)  RC(NC)  RC(NC)  RC(1,6) RC(1,7) RC(1,8) RC(1,9)
            RC(2,1) RC(2,2) RC(2,3) RC(2,4) RC(2,5) RC(2,6) RC(2,7) RC(2,8) RC(2,9)
            RC(3,1) RC(3,2) RC(3,3) RC(3,4) RC(3,5) RC(3,6) RC(3,7) RC(3,8) RC(3,9)
            RC(4,1) RC(4,2) RC(4,3) RC(4,4) RC(NC)  RC(4,6) RC(4,7) RC(4,8) RC(NC)
            RC(5,1) RC(5,2) RC(5,3) RC(5,4) RC(5,5) RC(5,6) RC(NC)  RC(5,8) RC(NC)
        >;
    };

    kscan0: kscan_0{
        compatible = "zmk,kscan-gpio-matrix";
        label = "KSCAN";
        diode-direction = "col2row"

   col-gpios = < 
    &pro_micro 4 GPIO_ACTIVE_HIGH   // P0.04
    &pro_micro 6 GPIO_ACTIVE_HIGH   // P0.06
    &pro_micro 8 GPIO_ACTIVE_HIGH   // P0.08
    &gpio0 20 GPIO_ACTIVE_HIGH      // P0.20 (pad lateral)
    &gpio0 22 GPIO_ACTIVE_HIGH      // P0.22 (pad lateral)
    &pro_micro 7 GPIO_ACTIVE_HIGH   // P0.24
    &pro_micro 10 GPIO_ACTIVE_HIGH  // P0.10
    &pro_micro 11 GPIO_ACTIVE_HIGH  // P0.11
    &pro_micro 13 GPIO_ACTIVE_HIGH  // P1.13
>;

row-gpios = <
    &pro_micro 15 GPIO_ACTIVE_HIGH  // P1.10
    &pro_micro 31 GPIO_ACTIVE_HIGH  // P1.02
    &pro_micro 14 GPIO_ACTIVE_HIGH  // P0.09
    &pro_micro 19 GPIO_ACTIVE_HIGH  // P1.15
    &pro_micro 30 GPIO_ACTIVE_HIGH  // P1.01
>;

    }
}
























